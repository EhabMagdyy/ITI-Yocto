## 01-BuildRecipe/conf/layer.conf
```bitbake
# We have a conf and classes directory, add to BBPATH
BBPATH .= ":${LAYERDIR}"

# We have recipes-* directories, add to BBFILES
BBFILES += "${LAYERDIR}/recipes-*/*/*.bb \
            ${LAYERDIR}/recipes-*/*/*.bbappend"

BBFILE_COLLECTIONS += "meta-weather"
BBFILE_PATTERN_meta-weather = "^${LAYERDIR}/"
BBFILE_PRIORITY_meta-weather = "6"

LAYERDEPENDS_meta-weather = "core"
LAYERSERIES_COMPAT_meta-weather = "scarthgap"

# Add the application to the image
IMAGE_INSTALL:append = " sayhi"
```

## 05-CustomDistro/conf/layer.conf
```bitbake
# We have a conf and classes directory, add to BBPATH
BBPATH .= ":${LAYERDIR}"

# We have recipes-* directories, add to BBFILES
BBFILES += "${LAYERDIR}/recipes-*/*/*.bb \
            ${LAYERDIR}/recipes-*/*/*.bbappend"

BBFILE_COLLECTIONS += "meta-customimage"
BBFILE_PATTERN_meta-customimage = "^${LAYERDIR}/"
BBFILE_PRIORITY_meta-customimage = "6"

LAYERDEPENDS_meta-customimage = "core"
LAYERSERIES_COMPAT_meta-customimage = "scarthgap"
```

## 06-FullCustomImage/conf/distro/ros.conf
```bitbake
DISTRO = "ros"
DISTRO_NAME = "ROS (Yocto Project Distro for ITI-GP)"
DISTRO_VERSION = "5.0.17"
DISTRO_CODENAME = "scarthgap"
SDK_VENDOR = "-rossdk"
SDK_VERSION = "${@d.getVar('DISTRO_VERSION').replace('snapshot-${METADATA_REVISION}', 'snapshot')}"
SDK_VERSION[vardepvalue] = "${SDK_VERSION}"

MAINTAINER = "Ehab Magdy <ehabmagdyabdullah@gmail.com>"

TARGET_VENDOR = "-ros"

LOCALCONF_VERSION = "2"

# Override these in poky based distros
POKY_DEFAULT_DISTRO_FEATURES = "opengl ptest multiarch wayland vulkan"
POKY_DEFAULT_EXTRA_RDEPENDS = "packagegroup-core-boot"
POKY_DEFAULT_EXTRA_RRECOMMENDS = "kernel-module-af-packet"

DISTRO_FEATURES ?= "${DISTRO_FEATURES_DEFAULT} ${POKY_DEFAULT_DISTRO_FEATURES}"

PREFERRED_VERSION_linux-yocto ?= "6.6%"
PREFERRED_VERSION_linux-yocto-rt ?= "6.6%"

SDK_NAME = "${DISTRO}-${TCLIBC}-${SDKMACHINE}-${IMAGE_BASENAME}-${TUNE_PKGARCH}-${MACHINE}"
SDKPATHINSTALL = "/opt/${DISTRO}/${SDK_VERSION}"

DISTRO_EXTRA_RDEPENDS += "${POKY_DEFAULT_EXTRA_RDEPENDS}"
DISTRO_EXTRA_RRECOMMENDS += "${POKY_DEFAULT_EXTRA_RRECOMMENDS}"

PACKAGE_CLASSES ?= "package_rpm"

SANITY_TESTED_DISTROS ?= " \
            poky-4.3 \n \
            poky-5.0 \n \
            ubuntu-20.04 \n \
            ubuntu-22.04 \n \
            ubuntu-23.04 \n \
            ubuntu-24.04 \n \
            fedora-38 \n \
            fedora-39 \n \
            fedora-40 \n \
            fedora-41 \n \
            centosstream-8 \n \
            centosstream-9 \n \
            debian-11 \n \
            debian-12 \n \
            opensuseleap-15.4 \n \
            almalinux-8.8 \n \
            almalinux-8.9 \n \
            almalinux-8.10 \n \
            almalinux-9.2 \n \
            almalinux-9.4 \n \
            rocky-8 \n \
            rocky-9 \n \
            "
# add poky sanity bbclass
INHERIT += "poky-sanity"

require conf/distro/include/poky-world-exclude.inc
require conf/distro/include/no-static-libs.inc
require conf/distro/include/yocto-uninative.inc
require conf/distro/include/security_flags.inc
INHERIT += "uninative"

BB_SIGNATURE_HANDLER ?= "OEEquivHash"
BB_HASHSERVE ??= "auto"

# We need debug symbols so that SPDX license manifests for the kernel work
KERNEL_EXTRA_FEATURES:append = " features/debug/debug-kernel.scc"

# Enable creation of SPDX manifests by default
INHERIT += "create-spdx"

DISTRO_FEATURES:append = " systemd usrmerge opengl wayland pam"

VIRTUAL-RUNTIME_init_manager = "systemd"
DISTRO_FEATURES_BACKFILL_CONSIDERED:append = " sysvinit"
LICENSE_FLAGS_ACCEPTED = "synaptics-killswitch"

MACHINE_FEATURES:append = " wifi bluetooth"

# Add a user named "iti" with password "iti" and add it to the sudo group
EXTRA_USERS_PARAMS = "\
    groupadd -r users; \
    groupadd -r sudo; \
    useradd -m -u 1001 -g users -G sudo -d /home/iti -s /bin/sh \
    -p '\$6\$iKA2P/PLTOuTd345\$r4qP9cHs2r8Yh8OnDHclbUz5b1tleYyBJRvmOzjEvP.8Gw/GvAwlqu9BmL.3tqK6cLULrMzmGjq11WKw4Oqn7.' iti; \
"

ROOT_HOME = "/root"

# Enable the VNC backend for Weston
PACKAGECONFIG:append:pn-weston = " vnc"
PACKAGECONFIG:append:pn-neatvnc = " tls"

VIRTUAL-RUNTIME_initscripts = "systemd-compat-units"
```

## build-rpi/conf/bblayers.conf
```bitbake
# POKY_BBLAYERS_CONF_VERSION is increased each time build/conf/bblayers.conf
# changes incompatibly
POKY_BBLAYERS_CONF_VERSION = "2"

BBPATH = "${TOPDIR}"
BBFILES ?= ""

BBLAYERS ?= " \
  /home/ehab/Documents/ITI_9Months/Yocto/poky/meta \
  /home/ehab/Documents/ITI_9Months/Yocto/poky/meta-poky \
  /home/ehab/Documents/ITI_9Months/Yocto/poky/meta-yocto-bsp \
  /home/ehab/Documents/ITI_9Months/Yocto/meta-raspberrypi \
  /home/ehab/Documents/ITI_9Months/Yocto/meta-weather \
  "
```
